## west_manifest/west.yml
```yaml
manifest:
  projects:
    - name: retroplc-runtime
      url: https://github.com/pcbpat/RetroPLC_Runtime.git
      revision: main
      import:
        path-prefix: workspace
  self:
    path: west_manifest
    west-commands: west-commands.yml
```
